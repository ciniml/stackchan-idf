## sdkconfig.defaults.atoms3
```kconfig
# M5Stack AtomS3 (no PSRAM) — slim profile.
# Selected by `make build BOARD=atoms3`.
#
# AtomS3 (product C014) is built on the ESP32-S3FN8 module: 8 MB external
# SPI flash, *no* PSRAM, 512 KiB internal SRAM. Drops every PSRAM-only
# feature (realtime AI conversation, BLE audio streaming, RTP receiver,
# camera + QR) and keeps the avatar / jtts / nekomimi LED / BLE+HTTP
# settings UI running from internal RAM.
#
# Pair with the Atomic ECHO BASE for jtts speech output and the nekomimi
# LED chain on GPIO38 (same as AtomNyan).

# --- PSRAM ---------------------------------------------------------------
# The N8 die has none — turn the SPIRAM driver off entirely so heap_caps
# allocators don't try to fall through to a non-existent pool and so the
# bootloader's PSRAM init step is skipped (saves boot time + a few KB).
CONFIG_SPIRAM=n

# --- Flash ---------------------------------------------------------------
# Same 8 MB layout as AtomS3R; partitions.csv uses 0x710000 (bootloader +
# nvs + 2× 3 MB OTA + 1 MB storage).
CONFIG_ESPTOOLPY_FLASHSIZE_8MB=y
CONFIG_ESPTOOLPY_FLASHSIZE="8MB"

# --- Feature gates -------------------------------------------------------
# Compile-time skip of everything that needs PSRAM. See main/Kconfig.projbuild
# for the flag definitions and main/app_main.cpp / main/CMakeLists.txt for
# where they take effect.
CONFIG_STACKCHAN_CONVERSATION_ENABLED=n
CONFIG_STACKCHAN_AUDIO_STREAM_ENABLED=n
CONFIG_STACKCHAN_WIFI_AUDIO_ENABLED=n
# Camera is already off by default in the common knob, but make it explicit
# here so a future flip in the base file doesn't accidentally enable it on
# the no-PSRAM target (esp32-camera mandates DMA + PSRAM frame buffers).
CONFIG_STACKCHAN_CAMERA_ENABLED=n

# --- Wi-Fi memory diet ---------------------------------------------------
# Without PSRAM the TX/RX rings + LWIP buffers compete with the avatar
# framebuffer (~128 × 128 × 2 B = 32 KiB) and jtts working memory in
# internal SRAM. Knocking the dynamic TX buffers down (from default 32) and
# disabling AMSDU + AMPDU TX trims the runtime footprint considerably. CLI
# verified: ~20 KiB heap saved against the cores3 baseline.
CONFIG_ESP_WIFI_DYNAMIC_TX_BUFFER_NUM=16
CONFIG_ESP_WIFI_STATIC_TX_BUFFER_NUM=4
CONFIG_ESP_WIFI_AMSDU_TX_ENABLED=n
CONFIG_ESP_WIFI_AMPDU_TX_ENABLED=n
# LWIP TCP windows: keep small enough to leave room for our own buffers
# but large enough that the settings/MCP HTTP endpoints aren't dog-slow.
CONFIG_LWIP_TCP_SND_BUF_DEFAULT=5760
CONFIG_LWIP_TCP_WND_DEFAULT=5760

# --- TLS / mbedTLS -------------------------------------------------------
# With conversation disabled we never open a TLS uplink, but the settings
# page's OTA paths still need mbedtls — and device-side release-fetch OTA
# (release_ota.cpp) downloads the .bin from www.fugafuga.org (GitHub Pages
# custom domain → Fastly CDN). Fastly emits full 16 KiB TLS records for bulk
# bodies; a 4 KiB inbound buffer makes the first esp_http_client_read fail
# with -0x7100 (MBEDTLS_ERR_SSL_BAD_INPUT_DATA — "requesting more data than
# fits" in mbedtls_ssl_fetch_input; the TLS record length is NOT clamped to
# IN_CONTENT_LEN in ssl_parse_record_header). 16384 (the TLS spec max) is the
# only value that guarantees a conformant record fits.
#
# Internal-RAM cost: AtomS3 has no PSRAM (SPIRAM=n above), so unlike the
# PSRAM boards these TLS record buffers live in internal SRAM. With
# MBEDTLS_DYNAMIC_BUFFER=y (inherited from sdkconfig.defaults) the 16 KiB RX
# buffer is only held while an OTA HTTPS connection is live and freed on
# close, and this profile opens at most one TLS conn at a time (no
# conversation / audio uplink). So the +12 KiB (16384 vs 4096) is a
# transient OTA-only peak, not a steady-state cost.
CONFIG_MBEDTLS_SSL_IN_CONTENT_LEN=16384
CONFIG_MBEDTLS_SSL_OUT_CONTENT_LEN=4096
```

## sdkconfig.defaults.atoms3r
```kconfig
# M5Stack AtomS3R + Atomic ECHO BASE — Atom-nyan board profile.
# Selected by `make build BOARD=atoms3r`.
#
# AtomS3R is built on the ESP32-S3-PICO-1-N8R8 module, whose 8 MB PSRAM is
# wired as Octal (OPI). The bootloader picks the mode at link time and a
# Quad-mode firmware can't probe the chip at all (PSRAM ID read error 0xff),
# so this is a separate firmware image from the CoreS3 one.
CONFIG_SPIRAM_MODE_OCT=y
# Octal PSRAM on the S3 supports 80 MHz reliably with the standard 40 MHz
# flash. (120 MHz is possible but requires CONFIG_ESPTOOLPY_FLASH_SAMPLE_MODE
# tuning that we don't need for the small avatar canvas.)
CONFIG_SPIRAM_SPEED_80M=y

# 8 MB external SPI flash (N8 half of the ESP32-S3-PICO-1-N8R8 module).
# Our partitions.csv uses 0x710000 of flash (bootloader + nvs + 2× 3 MB OTA
# + 1 MB storage), comfortably under 8 MB.
CONFIG_ESPTOOLPY_FLASHSIZE_8MB=y
CONFIG_ESPTOOLPY_FLASHSIZE="8MB"

# アプリが 3 MB を超えたため app 領域を拡張した 8 MB 表を使う (partitions_8mb.csv)。
# 移行は USB 書き込み必須・storage データはリセット (旧表の機体は OTA 不可)。
CONFIG_PARTITION_TABLE_CUSTOM_FILENAME="partitions_8mb.csv"

# HMM (hts_engine) 音声合成。専用 voice パーティションは無い (8 MB) ので、
# hmm_voice が待機側 OTA スロットをボイス置き場に流用する (OTA 更新で消える)。
CONFIG_JTTS_ENABLE_HMM=y

# HMM の idle 合成 (ランダム発話) は main タスク (run_demo_loop) 上で走り、
# hts のラベル生成 + 合成が既定 8 KiB スタックを溢れさせる (cores3/stopwatch と
# 同じ理由で 16 KiB 必要)。HMM 有効ボードでは必須。
CONFIG_ESP_MAIN_TASK_STACK_SIZE=16384
```

## sdkconfig.defaults.cores3
```kconfig
# M5Stack CoreS3 (ESP32-S3R8 — Quad SPI PSRAM) board-specific overrides.
# Selected by `make build BOARD=cores3` (default).
#
# CoreS3 uses the ESP32-S3R8 in-package PSRAM in Quad mode @ 80 MHz. Octal
# would not even ID-probe on this chip — picking the right mode is a
# build-time decision (handled in the bootloader before app code runs).
CONFIG_SPIRAM_MODE_QUAD=y
CONFIG_SPIRAM_SPEED_80M=y

# 16 MB external SPI flash (W25Q128 footprint on the CoreS3 PCB).
CONFIG_ESPTOOLPY_FLASHSIZE_16MB=y
CONFIG_ESPTOOLPY_FLASHSIZE="16MB"

# GC0308 DVP camera (CoreS3 mainboard) — Phase 1+2 connpass-QR feature.
# Pulls espressif/esp32-camera + espressif/quirc into the build and
# unlocks components/board/camera_gc0308.cpp. Pin defaults live in
# components/board/Kconfig and target the CoreS3 mainboard wiring.
#
# Re-enabled for the settings-page one-shot capture (GET /api/camera/capture).
# History: the boot-time QR test used to re-trigger the lgfx i2c mutex
# priority-disinherit assert (tasks.c:5147) ~38 s into boot, around the time
# GC0308 SCCB init runs on the same pins (G11/G12) as M5.In_I2C / led_strip.
# CameraGc0308::begin() calls m5::In_I2C.release() before esp_camera_init,
# but that does not stop other tasks (led refresh, touch poll, py32 LED
# refresh) from racing on the lgfx mutex during SCCB activity.
# The one-shot capture keeps the SCCB window to ~1 s per button press (vs a
# continuously-running QR scan), which is the current exposure while the bus
# ownership story gets sorted properly (gate led / touch / py32 I2C behind a
# "camera-active" flag, or migrate them off the shared lgfx i2c instance).
# STACKCHAN_QR_TEST_AT_BOOT stays OFF — do not flip it back on without
# revisiting the race.
CONFIG_STACKCHAN_CAMERA_ENABLED=y
# DMA path selection (ESP32-S3 knob in esp32-camera).
#   y: EDMA writes each line straight into the PSRAM framebuffer.
#   n: DMA lands in small internal-RAM bounce buffers; the cam task memcpys
#      into the PSRAM fb.
# Direct-to-PSRAM (y) worked for the 1 B/px grayscale QR path, but at
# RGB565's 2 B/px the EDMA writes lose the PSRAM bus to concurrent traffic
# (Quad PSRAM @80 MHz is ~40 MB/s total; NimBLE pools + heap live there
# too) and captured frames arrive with bands of torn pixels — confirmed on
# hardware 2026-07-03, even with the render task quiesced. Bounce mode (n)
# absorbs bus-arbitration stalls in internal RAM at the cost of a few KiB
# of DMA buffers; the 12 KiB internal-RAM floor check in
# CameraGc0308::begin() still gates the init.
CONFIG_CAMERA_PSRAM_DMA=n
# Bounce-buffer sizing. The esp32-camera default (32768) makes cam_dma_config
# ask for a 30 720 B contiguous internal block — the live system's largest
# free block is ~14 KiB, so init failed outright. 8192 shrinks the request to
# 2 × 3 840 B halves (7 680 B total, one 6-line node per half), which fits
# the steady-state heap with margin. Cost: an interrupt per 6 lines instead
# of per 24 — negligible against the one-shot capture duty cycle.
CONFIG_CAMERA_DMA_BUFFER_SIZE_MAX=8192

# --- esp32-camera sensor selection ---
# Disable every sensor driver except GC0308 (the only sensor on the CoreS3
# mainboard).  Each disabled driver would otherwise contribute its register-
# initialisation tables to .dram0.data / .dram1.* inside .dram0.data, eating
# internal RAM that TLS / esp-aes / NimBLE need at Wi-Fi bring-up:
#   hm1055  ≈ 2648 B, hm0360 ≈ 1864 B, nt99141 ≈ 1733 B,
#   ov3660  ≈  991 B, ov5640  ≈  755 B, ov2640  ≈  654 B,
#   ov7670  ≈  152 B, + smaller contributions from ov7725 / gc2145 / gc032a /
#   bf3005 / bf20a6 / sc030iot / mega_ccm.
# Total expected saving: ~9–10 KB of static DRAM, eliminating the heap-
# corruption / esp_timer panic seen at Wi-Fi peak.
CONFIG_OV7670_SUPPORT=n
CONFIG_OV7725_SUPPORT=n
CONFIG_NT99141_SUPPORT=n
CONFIG_OV2640_SUPPORT=n
CONFIG_OV3660_SUPPORT=n
CONFIG_OV5640_SUPPORT=n
CONFIG_GC2145_SUPPORT=n
CONFIG_GC032A_SUPPORT=n
CONFIG_GC0308_SUPPORT=y
CONFIG_BF3005_SUPPORT=n
CONFIG_BF20A6_SUPPORT=n
CONFIG_SC030IOT_SUPPORT=n
CONFIG_HM1055_SUPPORT=n
CONFIG_HM0360_SUPPORT=n
CONFIG_MEGA_CCM_SUPPORT=n

# 16 MB flash: 末尾に HMM 合成の voice パーティション (4 MB) を追加した
# パーティション表を使う。先頭は共通表と一致 (既存データ引き継ぎ)。
# 旧表の機体では voice パーティションが見えず HMM はフォールバック動作。
CONFIG_PARTITION_TABLE_CUSTOM_FILENAME="partitions_16mb.csv"

# HMM (hts_engine) 音声合成エンジン
CONFIG_JTTS_ENABLE_HMM=y

# hts_engine の合成 (ラベル パース等のスタック ローカル) が main タスクの
# 既定 8 KB を溢れさせるため増量。
CONFIG_ESP_MAIN_TASK_STACK_SIZE=16384
```

## sdkconfig.defaults.stopwatch
```kconfig
# M5Stack StopWatch (C152) — 1.75" AMOLED 円形 + ES8311 + MEMS MIC + M5PM1
# PMIC + M5IOE1 IO expander + RX8130CE RTC + BMI270 IMU + 振動モータ.
# Selected by `make build BOARD=stopwatch`.
#
# ESP32-S3R8 module: 16 MB external SPI flash + 8 MB in-package Octal PSRAM
# (the `R8` suffix is the Octal-PSRAM variant). M5Unified ≥ 0.2.17 / M5GFX
# ≥ 0.2.23 handle Panel_CO5300 autodetect, M5PM1 power backend, RX8130CE RTC
# and the ES8311 speaker/mic enable callbacks — so as long as we land here
# with the right PSRAM mode + flash size, `M5.begin()` brings up the AMOLED
# / touch / audio stack on its own.
CONFIG_SPIRAM_MODE_OCT=y
CONFIG_SPIRAM_SPEED_80M=y
CONFIG_ESPTOOLPY_FLASHSIZE_16MB=y
CONFIG_ESPTOOLPY_FLASHSIZE="16MB"

# Free UART0 (G43 TX / G44 RX) for the back-side 2.54 mm bus — it's the only
# UART exposed there, so anything wanting to drive an external SCS bus or
# console-via-3.3V from the back will route through it. Push the ESP-IDF
# console + idf.py monitor onto USB-Serial-JTAG instead so the two can't
# fight over UART0 pins.
CONFIG_ESP_CONSOLE_USB_SERIAL_JTAG=y
# UART0 stays unconfigured here; sub-components opt in via their own pin
# selection (e.g. scs_servo in a future Phase 3 servo-enable path).

# StopWatch has no DVP camera. Make sure CONFIG_STACKCHAN_CAMERA_ENABLED
# stays off (the cores3 profile is the only one that flips it to y).
CONFIG_STACKCHAN_CAMERA_ENABLED=n

# 16 MB flash: 末尾に HMM 合成の voice パーティション (4 MB) を追加した
# パーティション表を使う。先頭は共通表と一致 (既存データ引き継ぎ)。
# 旧表の機体では voice パーティションが見えず HMM はフォールバック動作。
CONFIG_PARTITION_TABLE_CUSTOM_FILENAME="partitions_16mb.csv"

# HMM (hts_engine) 音声合成エンジン
CONFIG_JTTS_ENABLE_HMM=y
```
